## config/boards/shields/dactyl/Kconfig.shield
```kconfig
# Copyright (c) 2020 Pete Johanson
# SPDX-License-Identifier: MIT

config SHIELD_dactyl_LEFT
    def_bool $(shields_list_contains,dactyl_left)

config SHIELD_dactyl_RIGHT
    def_bool $(shields_list_contains,dactyl_right)
```
